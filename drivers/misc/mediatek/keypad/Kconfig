## drivers/misc/mediatek/keypad/Kconfig
```kconfig
config MTK_KEYPAD
	tristate "MediaTek Keypad driver"
	default n
	---help---
	  Keypad driver support for MediaTek SOC.
	  If you want to use MediaTek Keypad driver, say Y here.
	  If unsure, say N.
```
